## boards/shields/seiboku/Kconfig.defconfig
```kconfig
if SHIELD_SEIBOKU

    config ZMK_KEYBOARD_NAME
        default "SEIBOKU"

    config INPUT
        bool
        default y

    config PMW3610
        bool
        default y

    config SPI
        bool
        default y

    config ZMK_BLE
        bool
        default y

    config ZMK_POINTING
        bool
        default y

endif
```

## boards/shields/seiboku/Kconfig.shield
```kconfig
# No whitespace after the comma or in your keyboard name!
config SHIELD_SEIBOKU
    def_bool $(shields_list_contains,seiboku)

config PMW3610_SCALE_X
    int "PMW3610 X Axis Scale (scaled by 10)"
    default 10
    help
      X 軸のスケール値を 10 倍の整数として設定します (例: 1.2 → 12)。

config PMW3610_SCALE_Y
    int "PMW3610 Y Axis Scale (scaled by 10)"
    default 10
    help
      Y 軸のスケール値を 10 倍の整数として設定します (例: 1.0 → 10)。
```

## config/west.yml
```yaml
manifest:
  remotes:
    - name: zmkfirmware
      url-base: https://github.com/zmkfirmware
    - name: badjeff
      url-base: https://github.com/badjeff
    # Additional modules containing boards/shields/custom code can be listed here as well
    # See https://docs.zephyrproject.org/3.2.0/develop/west/manifest.html#projects
  projects:
    - name: zmk
      remote: zmkfirmware
      revision: v0.2.1
      import: app/west.yml
    - name: zmk-pmw3610-driver
      remote: badjeff
      revision: main
  self:
    path: config
```
